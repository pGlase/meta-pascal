## conf/layer.conf
```bitbake
# We have a conf and classes directory, add to BBPATH
BBPATH .= ":${LAYERDIR}"

# We have a packages directory, add to BBFILES
BBFILES += "${LAYERDIR}/recipes-*/*/*.bb \
            ${LAYERDIR}/recipes-*/*/*.bbappend"

BBFILE_COLLECTIONS += "pascal-layer"
BBFILE_PATTERN_pascal-layer := "^${LAYERDIR}/"
BBFILE_PRIORITY_pascal-layer = "20"

# This should only be incremented on significant changes that will
# cause compatibility issues with other layers
LAYERVERSION_pascal-layer = "1"

LAYERDEPENDS_pascal-layer = "core openembedded-layer security raspberrypi "

LAYERSERIES_COMPAT_pascal-layer = "zeus"
# kudge: remove TPM1.2-tools here until distro and board are seperated
BBMASK += "/meta-security/meta-tpm/recipes-tpm/"
```
